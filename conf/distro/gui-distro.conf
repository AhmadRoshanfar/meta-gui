## conf/distro/gui-distro.conf
```bitbake
require conf/distro/poky.conf

DISTRO = "GUI-distro"
DISTRO_NAME = "Qt GUI Distro"

DISTRO_FEATURES:remove = "3g x11 wayland bluetooth pulseaudio gstreamer wifi nfc vulkan nfs ipv6 ext2 alsa acl"
# INIT_MANAGER = "systemd"
POKY_INIT_MANAGER:rscan-distro = "systemd"
```

## conf/distro/rscan-distro.conf
```bitbake
require conf/distro/poky.conf

DISTRO = "rscan-distro"
DISTRO_NAME = "R-Scan Distro"

DISTRO_FEATURES:remove = "3g x11 wayland bluetooth pulseaudio gstreamer wifi nfc vulkan nfs ipv6 ext2 alsa acl"
# INIT_MANAGER = "systemd"
POKY_INIT_MANAGER:rscan-distro = "systemd"
```

## conf/layer.conf
```bitbake
# We have a conf and classes directory, add to BBPATH
BBPATH .= ":${LAYERDIR}"

# We have recipes-* directories, add to BBFILES
BBFILES += "${LAYERDIR}/recipes-*/*/*.bb \
            ${LAYERDIR}/recipes-*/*/*.bbappend"

BBFILE_COLLECTIONS += "meta-rscan"
BBFILE_PATTERN_meta-rscan = "^${LAYERDIR}/"
BBFILE_PRIORITY_meta-rscan = "6"

LAYERDEPENDS_meta-rscan = "core"
LAYERSERIES_COMPAT_meta-rscan = "scarthgap"
```
